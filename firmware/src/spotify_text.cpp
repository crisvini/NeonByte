#include "neonbyte/spotify_text.h"

#include <algorithm>

#if defined(ARDUINO_ARCH_ESP8266)
#include <pgmspace.h>
#define NEONBYTE_SPOTIFY_PROGMEM PROGMEM
#else
#define NEONBYTE_SPOTIFY_PROGMEM
#define pgm_read_byte(address) (*(address))
#endif

namespace neonbyte {
namespace {

constexpr std::uint8_t FIRST_PRINTABLE_ASCII = 32;
constexpr std::uint8_t LAST_PRINTABLE_ASCII = 126;
constexpr std::size_t CLASSIC_FONT_WIDTH = 5;
constexpr std::size_t CLASSIC_FONT_HEIGHT = 8;
constexpr std::size_t CLASSIC_CELL_WIDTH = 6;
constexpr std::size_t FONT_SCALE = 2;

// Adafruit GFX 1.11.11 classic ASCII 5x7 font, stored by columns.
// Only the 95 printable glyphs accepted by the existing text cache are needed.
// The upstream BSD terms are reproduced in firmware/LICENSES/Adafruit-GFX-BSD.txt.
const std::uint8_t CLASSIC_ASCII_FONT[] NEONBYTE_SPOTIFY_PROGMEM = {
    0x00, 0x00, 0x00, 0x00, 0x00, 0x00, 0x00, 0x5f, 0x00, 0x00, 0x00, 0x07, 0x00, 0x07, 0x00,
    0x14, 0x7f, 0x14, 0x7f, 0x14, 0x24, 0x2a, 0x7f, 0x2a, 0x12, 0x23, 0x13, 0x08, 0x64, 0x62,
    0x36, 0x49, 0x56, 0x20, 0x50, 0x00, 0x08, 0x07, 0x03, 0x00, 0x00, 0x1c, 0x22, 0x41, 0x00,
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    0x00, 0x41, 0x36, 0x08, 0x00, 0x02, 0x01, 0x02, 0x04, 0x02,
};
static_assert(sizeof(CLASSIC_ASCII_FONT) == 95 * CLASSIC_FONT_WIDTH);

} // namespace

bool composeSpotifyTextRow(std::string_view text, std::uint16_t offset, std::uint8_t row,
                           std::uint16_t color, std::uint8_t* output,
                           std::size_t outputCapacity) {
    if (output == nullptr || outputCapacity < SPOTIFY_TEXT_ROW_BYTES ||
        row >= SPOTIFY_TEXT_ROW_HEIGHT || text.size() > SPOTIFY_TEXT_MAX_CODE_POINTS) {
        return false;
    }

    std::fill_n(output, SPOTIFY_TEXT_ROW_BYTES, std::uint8_t{0});
    const int textLeft = 8 - static_cast<int>(offset);
    const int rowPixel = static_cast<int>(row / FONT_SCALE);
    if (rowPixel >= static_cast<int>(CLASSIC_FONT_HEIGHT)) return true;

    const int firstScreenX = std::max(0, textLeft);
    const int lastScreenX = std::min(
        static_cast<int>(SPOTIFY_TEXT_ROW_WIDTH),
        textLeft + static_cast<int>(text.size() * CLASSIC_CELL_WIDTH * FONT_SCALE));
    for (int screenX = firstScreenX; screenX < lastScreenX; ++screenX) {
        const unsigned sourceX = static_cast<unsigned>(screenX - textLeft);
        const unsigned characterIndex = sourceX / (CLASSIC_CELL_WIDTH * FONT_SCALE);
        const unsigned cellColumn = (sourceX / FONT_SCALE) % CLASSIC_CELL_WIDTH;
        if (cellColumn >= CLASSIC_FONT_WIDTH) continue;

        const auto inputCharacter = static_cast<unsigned char>(text[characterIndex]);
        const std::uint8_t character =
            inputCharacter >= FIRST_PRINTABLE_ASCII && inputCharacter <= LAST_PRINTABLE_ASCII
                ? inputCharacter
                : static_cast<std::uint8_t>('?');
        const std::size_t glyphOffset =
            static_cast<std::size_t>(character - FIRST_PRINTABLE_ASCII) * CLASSIC_FONT_WIDTH +
            cellColumn;
        const std::uint8_t column = pgm_read_byte(&CLASSIC_ASCII_FONT[glyphOffset]);
        if ((column & (1U << rowPixel)) == 0) continue;

        const auto pixelOffset = static_cast<std::size_t>(screenX) * 2;
        output[pixelOffset] = static_cast<std::uint8_t>(color);
        output[pixelOffset + 1] = static_cast<std::uint8_t>(color >> 8);
    }
    return true;
}

} // namespace neonbyte

#undef NEONBYTE_SPOTIFY_PROGMEM
#if !defined(ARDUINO_ARCH_ESP8266)
#undef pgm_read_byte
#endif
